## boards/arm/sma3/Kconfig.board
```kconfig
# nRF52833 DK NRF52833 board configuration

# Copyright (c) 2019 Nordic Semiconductor ASA
# SPDX-License-Identifier: Apache-2.0

config BOARD_SMA3
	bool "sma3"
	depends on SOC_NRF52833_QIAA
```

## boards/arm/sma3/Kconfig.defconfig
```kconfig
# nRF52833 DK NRF52833 board configuration

# Copyright (c) 2019 Nordic Semiconductor ASA
# SPDX-License-Identifier: Apache-2.0

if BOARD_SMA3

config BOARD
	default "sma3"

config BT_CTLR
	default BT

endif # BOARD_SMA3
```
